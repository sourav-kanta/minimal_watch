#include "ble_types.h"
#include <zephyr/logging/log.h>
#include "BLE/ble_fifo.h"

LOG_MODULE_REGISTER(BLE_PACKET_HANDLER, LOG_LEVEL_INF);

static ble_msg_t tx_cur_msg;
static uint16_t tx_offset = 0;
static uint8_t tx_msg_active = 0;

typedef struct {
    rx_state_t state;
    ble_msg_t cur_msg;
    uint16_t offset;
    uint8_t msg_active;
} rx_ctx_t;

static rx_ctx_t rx_ctx;

void rx_reset_context()
{
    rx_ctx.state = RX_WAIT_MAGIC;
    rx_ctx.offset = 0;
    rx_ctx.msg_active = 0;
}

void tx_reset_context() {
    tx_msg_active = 0;
    tx_offset = 0;
}

/**
 * @brief Builds the next BLE TX packet from the internal message FIFO.
 *
 * This function encodes one MTU-sized BLE packet into the global TX buffer
 * (`tx_buffer`) by consuming messages from the internal FIFO.
 * 
 * @verbatim
 * It performs message fragmentation across packets while preserving message
 * boundaries using a per-message header and a continuation flag at packet level.
 *
 * ---
 *
 * ## Wire Format
 *
 * Each BLE packet generated by this function has the following format:
 *
 * ```
 * [ MSG_CONT ][ MESSAGE STREAM ... ]
 * ```
 *
 * Where:
 *
 * - MSG_CONT (1 byte)
 *      - 1 = continuation of previous message stream
 *      - 0 = new stream start
 *
 * Each message inside the stream has the format:
 *
 * ```
 * [ MAGIC ][ OPCODE ][ REQ_APP ][ LEN ][ PAYLOAD... ]
 * ```
 *
 * Where:
 *
 * - MAGIC   : 1 byte message boundary identifier
 * - OPCODE  : application-defined command opcode
 * - REQ_APP : requesting application ID
 * - LEN     : payload length in bytes
 * - PAYLOAD : variable length data (may be fragmented across packets)
 *
 * ---
 *
 * ## Fragmentation Rules
 *
 * - Only the PAYLOAD field may be fragmented across multiple BLE packets.
 * - Message headers are always sent atomically (never split).
 * - Messages are read sequentially from the FIFO.
 * - If a message does not fully fit in the current MTU, it is continued in
 *   the next packet without repeating the header.
 *
 * --- 
 * @endverbatim
 * 
 * @param out_len 
 *
 * @return Returns true if packet contains data, false if FIFO empty
 */
bool ble_build_next_packet(uint8_t* tx_buffer, uint16_t effective_mtu, uint16_t *out_len)
{
    if (!out_len) return false;

    uint16_t i = 0;
    LOG_INF("Build packet for MTU : %02u", effective_mtu);
    // packet-level continuation flag
    tx_buffer[i++] = tx_msg_active ? 1 : 0;

    while (i < effective_mtu) {

        /* Load next message if needed */
        if (!tx_msg_active) {
            if (!get_next_ble_msg(&tx_cur_msg, BLE_TX)) {
                break; // FIFO empty
            }

            tx_offset = 0;
            tx_msg_active = 1;
        }

        uint16_t remaining_msg = tx_cur_msg.hdr.len - tx_offset;
        uint16_t remaining_pkt = effective_mtu - i;

        /* Ensure header fits when starting a new message */
        if (tx_offset == 0 && remaining_pkt < (1 + BLE_HDR_SIZE)) {
            break;
        }

        /* Write message header once per message */
        if (tx_offset == 0) {

            tx_buffer[i++] = BLE_MAGIC;

            tx_buffer[i++] = tx_cur_msg.hdr.opcode;
            tx_buffer[i++] = tx_cur_msg.hdr.req_app;
            tx_buffer[i++] = tx_cur_msg.hdr.len;
        }

        remaining_pkt = effective_mtu - i;
        uint16_t chunk = (remaining_msg < remaining_pkt)
                            ? remaining_msg
                            : remaining_pkt;

        memcpy(&tx_buffer[i], &tx_cur_msg.payload[tx_offset], chunk);
        i += chunk;
        tx_offset += chunk;

        /* message complete */
        if (tx_offset >= tx_cur_msg.hdr.len) {
            tx_msg_active = 0;
        }

        /* packet full */
        if (i >= effective_mtu) break;
    }

    *out_len = i;
    return (i > 1);
}

void dump_ble_packet(const uint8_t *pkt, uint16_t len)
{
    if (!pkt || len == 0) {
        LOG_INF("EMPTY PACKET");
        return;
    }

    uint16_t i = 0;
    uint8_t msg_cont = pkt[i++];

    LOG_INF("BLE PACKET DUMP");
    LOG_INF("MSG_CONT: %u", msg_cont);

    /* =========================================================
     * STREAM MODE (BOTH CONTINUATION AND START BEHAVES SAME)
     * ========================================================= */
    while (i < len) {

        /* Wait for message boundary */
        if (pkt[i] != BLE_MAGIC) {

            LOG_INF("RAW [%u]: 0x%02X", i, pkt[i]);
            i++;
            continue;
        }

        /* ---- MESSAGE START ---- */
        i++; // skip MAGIC

        if (i + 3 > len) {
            LOG_INF("TRUNCATED HEADER");
            return;
        }

        uint8_t opcode  = pkt[i++];
        uint8_t req_app = pkt[i++];
        uint8_t msg_len = pkt[i++];

        LOG_INF("---- MESSAGE ----");
        LOG_INF("OPCODE  : 0x%02X", opcode);
        LOG_INF("REQ_APP : %u", req_app);
        LOG_INF("LEN     : %u", msg_len);

        uint16_t remaining = len - i;
        uint16_t available = (msg_len < remaining) ? msg_len : remaining;

        LOG_INF("PAYLOAD:");

        for (uint16_t k = 0; k < available; k++) {
            LOG_INF("  [%u] 0x%02X", k, pkt[i + k]);
        }

        if (available < msg_len) {
            LOG_INF("  ... TRUNCATED (%u/%u)", available, msg_len);
        }

        i += available;
    }

    LOG_INF("END PACKET");
}


void ble_retrieve_packet(const uint8_t *pkt, uint16_t len)
{
    if (!pkt || len == 0) return;

    uint16_t i = 0;

    uint8_t msg_cont = pkt[i++];

    /* =========================================================
     * CONTINUATION HANDLING
     * ========================================================= */
    if (msg_cont == 0) {
        /* New stream → reset parser */
        rx_ctx.state = RX_WAIT_MAGIC;
        rx_ctx.offset = 0;
        rx_ctx.msg_active = 0;
    }
    else {
        /* Continuation expected but no active message → resync */
        if (!rx_ctx.msg_active) {
            LOG_ERR("Unexpected continuation packet → resync");
            rx_ctx.state = RX_WAIT_MAGIC;
            rx_ctx.offset = 0;
        }
    }

    /* =========================================================
     * STREAM PARSER
     * ========================================================= */
    while (i < len) {

        switch (rx_ctx.state) {

        /* ---------------- WAIT FOR MAGIC ---------------- */
        case RX_WAIT_MAGIC:

            if (pkt[i] != BLE_MAGIC) {
                i++; /* Skip garbage */
                break;
            }

            // Handling edge case where we are already in desync and trying to 
            // find next magic, say we get magic in last byte of packet now we 
            // shouldnt consume the magic and set state to header as header
            // will start from next packet first byte (MSG_CONT flag byte) and
            // fail copying garbage in payload (as len is incorrect)
            if (i + 4 > len) {
               /* Not enough bytes for full header → wait next packet */
                LOG_ERR("Protocol violation: partial header detected at packet boundary");
                return;   
            }

            /* Found potential message start */
            rx_ctx.state = RX_READ_HEADER;
            i++;
            break;

        /* ---------------- READ HEADER ---------------- */
        case RX_READ_HEADER:

            if (i + 3 > len) {
                /* Incomplete header → wait next packet */
                return;
            }

            rx_ctx.cur_msg.hdr.opcode  = pkt[i++];
            rx_ctx.cur_msg.hdr.req_app = pkt[i++];
            rx_ctx.cur_msg.hdr.len     = pkt[i++];

            /* Length validation */
            if (rx_ctx.cur_msg.hdr.len > MAX_BLE_PAYLOAD_SIZE) {
                LOG_ERR("Invalid length: %u", rx_ctx.cur_msg.hdr.len);

                /* Resync instead of drop-all */
                rx_ctx.state = RX_WAIT_MAGIC;
                rx_ctx.msg_active = 0;
                break;
            }

            rx_ctx.offset = 0;
            rx_ctx.msg_active = 1;

            /* ----------- HANDLE EMPTY PAYLOAD ----------*/
            if (rx_ctx.cur_msg.hdr.len == 0) {

                add_ble_msg_to_queue(&rx_ctx.cur_msg, BLE_RX);

                rx_ctx.msg_active = 0;
                rx_ctx.state = RX_WAIT_MAGIC;
                break;
            }

            rx_ctx.state = RX_READ_PAYLOAD;
            break;

        /* ---------------- READ PAYLOAD ---------------- */
        case RX_READ_PAYLOAD: {
            /* Prevent overflow in case of corruption */
            if (rx_ctx.offset > rx_ctx.cur_msg.hdr.len) {
                LOG_ERR("RX offset overflow → resync");
                rx_ctx.state = RX_WAIT_MAGIC;
                rx_ctx.msg_active = 0;
                break;
            }
            uint16_t remaining_msg = rx_ctx.cur_msg.hdr.len - rx_ctx.offset;
            uint16_t remaining_pkt = len - i;

            uint16_t chunk = (remaining_msg < remaining_pkt)
                                ? remaining_msg
                                : remaining_pkt;

            memcpy(&rx_ctx.cur_msg.payload[rx_ctx.offset], &pkt[i], chunk);

            rx_ctx.offset += chunk;
            i += chunk;

            /* Message complete */
            if (rx_ctx.offset >= rx_ctx.cur_msg.hdr.len) {

                add_ble_msg_to_queue(&rx_ctx.cur_msg, BLE_RX);

                rx_ctx.msg_active = 0;
                rx_ctx.state = RX_WAIT_MAGIC;
            }

            break;
        }

        default:
            rx_ctx.state = RX_WAIT_MAGIC;
            break;
        }
    }
}
